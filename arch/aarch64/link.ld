/* aarch64 kernel image layout for QEMU's `virt` machine.
 *
 * RAM on `virt` begins at 0x40000000, and the image is linked 2 MiB above it at
 * 0x40200000 so that the device tree fits underneath.
 *
 * It used to be linked at 0x40080000 — the Linux arm64 "text offset" — with a comment
 * claiming the half megabyte below was where QEMU puts the device tree. That was wrong,
 * and silently so. QEMU places the DTB below an ELF kernel only if it fits, and skips it
 * without a word when it does not; the `virt` tree is 1 MiB (`totalsize 0x100000`), and
 * half a megabyte cannot hold it. A scan of all guest RAM found no `d00dfeed` anywhere,
 * and QEMU's `info roms` listed no DTB. The device-tree parser was built, tested and
 * working, and still found nothing, because there was nothing to find.
 *
 * 0x40200000 leaves 2 MiB, and is a 2 MiB block boundary, so the image starts exactly
 * where the boot map's first refined block begins.
 *
 * There is no header to place first here, unlike multiboot on x86: QEMU loads an ELF
 * and jumps to its entry point, so `.text.boot` leads only so that `_start` sits at a
 * predictable address for a debugger.
 *
 * Like x86_64 this is a Phase 0 identity layout: the image is linked at the physical
 * address it is loaded at. Moving the kernel to the high half is Phase 1 work.
 *
 * # Why every boundary is page-aligned
 *
 * The three ranges below are handed to the address-space builder through
 * `hal::ImageSections`, which maps `.text` read+execute, `.rodata` read-only and
 * `.data`+`.bss` read+write+no-execute. A permission boundary is a property of a page,
 * not of a byte: if `.text` ended halfway through a page the page holding both its tail
 * and `.rodata`'s head would have to be mapped with the union of the two — writable and
 * executable at once is exactly what the split exists to prevent. So each section is
 * aligned at its start *and* padded to a page at its end, and the symbols marking them
 * are therefore page-aligned on both sides by construction.
 *
 * # The stack guard
 *
 * `.stack_guard` is a page of nothing between `.bss` and the boot stack, reserved so
 * that the builder can leave it unmapped. Without it a stack overflow runs quietly off
 * the bottom of the stack into whatever the linker placed below — here that would be
 * the translation tables, which are in `.bss` — and the machine is gone before any
 * handler can say so. With it, the overflowing store takes a translation fault at a
 * known address, which the exception path can report.
 *
 * It is deliberately its own output section rather than padding inside `.bss`: a hole
 * that shows up in `llvm-objdump -h` is a hole somebody can check, and nothing can
 * drift into it. It is also outside `[__bss_start, __bss_end)`, so even the boot
 * zeroing loop never touches it.
 */

ENTRY(_start)

/* One 4 KiB page — the granule this port configures in TCR_EL1.TG0. Every boundary
 * below is a multiple of it. */
PAGE_SIZE = 4K;

/* See `.thread_stacks` below. */
/* THREAD_STACK_SLOT and THREAD_STACK_SLOTS: the geometry the configuration asks for,
 * generated by kbuild beside `config.rs` and found through the `-L` the link is given.
 * See `.thread_stacks` below and `codegen::stacks`. */
INCLUDE stacks.ld
/* CONFIG_BOOT_STACK_KIB, which sizes `.stack` below; see docs/build-system.md. */
INCLUDE sizes.ld


SECTIONS {
    . = 0x40200000;
    __kernel_start = .;

    .text : ALIGN(PAGE_SIZE) {
        __text_start = .;
        KEEP(*(.text.boot))
        *(.text .text.*)
        . = ALIGN(PAGE_SIZE);
        __text_end = .;
    }

    .rodata : ALIGN(PAGE_SIZE) {
        __rodata_start = .;
        /* The build ID kbuild stamps after linking; see lib/buildid. */
        KEEP(*(.kintane_build_id))
        *(.rodata .rodata.*)
        . = ALIGN(PAGE_SIZE);
        __rodata_end = .;
    }

    /* `.data`, `.bss` and the boot stack are one permission region — read, write, never
     * execute — so `__data_start` opens here and `__data_end` closes past the stack. */
    .data : ALIGN(PAGE_SIZE) {
        __data_start = .;
        *(.data .data.*)
        /* A static, non-PIE aarch64 link should need no GOT at all, but LLD will
         * still synthesise one for a stray absolute reference. Naming it keeps it
         * inside a loaded segment rather than orphaned at an arbitrary address. */
        *(.got .got.plt)
    }

    .bss : ALIGN(PAGE_SIZE) {
        __bss_start = .;
        *(.bss .bss.*)
        *(COMMON)
        /* The zeroing loop in boot.rs stores 8 bytes at a time and stops on `>=`, so
         * the end must be a multiple of 8 or the last word is skipped. Rounding to a
         * whole page satisfies that and also puts the guard page immediately above,
         * with no byte of `.bss` sharing a page with it. */
        . = ALIGN(PAGE_SIZE);
        __bss_end = .;
    }

    .stack_guard (NOLOAD) : ALIGN(PAGE_SIZE) {
        __stack_guard_start = .;
        . += PAGE_SIZE;
        __stack_guard_end = .;
    }

    /* The boot stack, grown downward from `__stack_top` towards the guard page: the
     * configured size, rounded up to a page so the guard below and the thread stacks above
     * stay page boundaries. `NOLOAD` like `.bss` but outside it, so it is not zeroed at
     * boot; nothing reads a stack slot it has not written. */
    .stack (NOLOAD) : ALIGN(PAGE_SIZE) {
        __stack_bottom = .;
        . += CONFIG_BOOT_STACK_KIB * 1K;
        . = ALIGN(PAGE_SIZE);
        __stack_top = .;
    }

    /* Kernel thread stacks: THREAD_STACK_SLOTS slots of THREAD_STACK_SLOT bytes, each a
     * guard page followed by the stack. Only the run is reserved here. The slot
     * geometry is `THREAD_STACK_SLOT` in `src/lib.rs`, and the address-space builder
     * leaves the bottom page of every slot unmapped, so a thread that overflows its
     * stack faults instead of writing into the stack of the thread below it. Last in
     * the writable run, so a slot's guard page is never the only thing between two
     * unrelated sections. */
    .thread_stacks (NOLOAD) : ALIGN(4K) {
        __thread_stacks_start = .;
        . += THREAD_STACK_SLOTS * THREAD_STACK_SLOT;
        __thread_stacks_end = .;
    }

    __data_end = .;
    __kernel_end = .;

    /DISCARD/ : {
        *(.eh_frame)
        *(.note .note.*)
        *(.comment)
    }
}

/* The layout above is load-bearing for W^X and for the guard page, and a silent
 * regression — an added section landing between two of these, an alignment lost in a
 * refactor — would show up as permissions quietly merging rather than as a link error.
 * These assertions make it a link error. */
ASSERT(__text_start % PAGE_SIZE == 0, "__text_start is not page-aligned")
ASSERT(__text_end % PAGE_SIZE == 0, "__text_end is not page-aligned")
ASSERT(__rodata_start % PAGE_SIZE == 0, "__rodata_start is not page-aligned")
ASSERT(__rodata_end % PAGE_SIZE == 0, "__rodata_end is not page-aligned")
ASSERT(__data_start % PAGE_SIZE == 0, "__data_start is not page-aligned")
ASSERT(__data_end % PAGE_SIZE == 0, "__data_end is not page-aligned")
ASSERT(__text_end <= __rodata_start, ".text and .rodata overlap")
ASSERT(__rodata_end <= __data_start, ".rodata and .data overlap")
ASSERT(__stack_guard_end - __stack_guard_start == PAGE_SIZE, "the stack guard is not one page")
ASSERT(__bss_end <= __stack_guard_start, ".bss runs into the stack guard")
ASSERT(__stack_guard_end <= __stack_top, "the stack guard overlaps the stack")
ASSERT(__stack_top - __stack_bottom == ALIGN(CONFIG_BOOT_STACK_KIB * 1K, PAGE_SIZE), "the boot stack is not BOOT_STACK_KIB, rounded up to a page")

/* The Rust side computes the slot count by shifting, and aarch64's exception entry tests
 * for a guard hit with a mask. Both need whole, page-aligned, power-of-two slots. */
ASSERT((THREAD_STACK_SLOT & (THREAD_STACK_SLOT - 1)) == 0, "THREAD_STACK_KIB is not a power of two, which hal::StackArray requires")
ASSERT(THREAD_STACK_SLOT >= 8K, "THREAD_STACK_KIB leaves no stack above the guard")
ASSERT(__thread_stacks_start % 4K == 0, "__thread_stacks_start is not page-aligned")
ASSERT((__thread_stacks_end - __thread_stacks_start) % THREAD_STACK_SLOT == 0, "thread stacks are not whole slots")
