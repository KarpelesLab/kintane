/* x86_64 kernel image layout.
 *
 * Linked at 1 MiB, the lowest address a multiboot loader will place a kernel above
 * the legacy low-memory region. The multiboot header must land in the first 8 KiB of
 * the file, which putting it at the very front of .text guarantees.
 *
 * This is deliberately a low-half identity-mapped layout for Phase 0. Moving the
 * kernel to the high half is Phase 1 work, and it changes the code model in
 * targets/x86_64-kintane.json from "small" to "kernel".
 *
 * ## Why every boundary is page-aligned
 *
 * The symbols below are what `image_sections()` reports and what the kernel address
 * space builder maps: .text read + execute, .rodata read-only, .data + .bss read +
 * write + no-execute. A section boundary in the middle of a page would force that
 * page to carry the union of both neighbours' permissions — a writable page holding
 * the tail of .text, or an executable one holding the head of .rodata — which is
 * exactly the thing the split exists to prevent. So each region is padded out to a
 * page at both ends and the padding is dead space nobody addresses.
 *
 * ## The layout, low to high, and why it is in this order
 *
 *     .text        read + execute
 *     .rodata      read-only
 *     [guard]      unmapped, in no section
 *     .stack       the boot stack, first thing in the writable region
 *     .data        }
 *     .bss         } everything else writable, including the early page tables
 *
 * The boot stack grows *down*, so what sits immediately below `__stack_bottom` is
 * what a stack overflow destroys. It used to be `pml4`/`pdpt`/`pd` — the live page
 * tables — which meant an overflow unmapped the machine, including the IST stack the
 * double-fault handler needs, and the run died in an endless #PF/#DF alternation with
 * no output at all. gdt.rs records that experiment.
 *
 * Now the page tables are above the stack, in .bss, and below the stack is a page
 * that belongs to no section and that the address space builder leaves unmapped. The
 * first push past the end of the stack faults on a page that was never mapped, #DF is
 * delivered on its IST, and the overflow is reported instead of being fatal.
 * .rodata sits below the guard page, so even a frame large enough to step over the
 * guard entirely lands on read-only memory rather than on anything load-bearing.
 */

ENTRY(_start)

/* THREAD_STACK_SLOT and THREAD_STACK_SLOTS: the geometry the configuration asks for,
 * generated by kbuild beside `config.rs` and found through the `-L` the link is given.
 * See `.thread_stacks` below and `codegen::stacks`. */
/* The configuration's numbers: CONFIG_BOOT_STACK_KIB sizes `.stack` below. */
INCLUDE sizes.ld
INCLUDE stacks.ld


SECTIONS {
    . = 1M;
    __kernel_start = .;

    .text : ALIGN(4K) {
        __text_start = .;
        /* First in the image so the header lands well inside the 8 KiB the multiboot
         * specification allows it. It is read-only data in an executable region,
         * which costs nothing and saves a page of its own. */
        KEEP(*(.multiboot_header))
        . = ALIGN(16);
        KEEP(*(.text.boot))
        *(.text .text.*)
        . = ALIGN(4K);
        __text_end = .;
    }

    /* First in the read-only region, and an output section of its own, so the linker
     * gives it a PT_NOTE program header: that is how a KinTane loader finds the
     * protocol entry point without scanning. It must be named before /DISCARD/,
     * which drops every other note. */
    . = ALIGN(4K);
    /* Page-aligned by the assignment above rather than by ALIGN(4K) on the section:
     * a note section's own alignment must be 4 or 8, or readers refuse its notes. */
    .note.kintane : {
        __rodata_start = .;
        KEEP(*(.note.kintane))
    }

    .rodata : {
        /* The build ID kbuild stamps after linking; see lib/buildid. */
        KEEP(*(.kintane_build_id))
        *(.rodata .rodata.*)
        . = ALIGN(4K);
        __rodata_end = .;
    }

    /* The guard page: a hole between two output sections, so it is inside none of
     * them and `image_sections()` can report it as land that must stay unmapped. */
    . = ALIGN(4K);
    __stack_guard_start = .;
    . = . + 4K;
    __stack_guard_end = .;

    /* The boot stack, first thing in the writable region so that the only thing below
     * it is the guard page. CONFIG_BOOT_STACK_KIB of it, from sizes.ld, rounded up to a
     * page; the alignment on both sides is here, because a stack whose bottom is not a
     * page boundary shares a page with whatever precedes it and the guard stops being a
     * boundary. */
    .stack (NOLOAD) : ALIGN(4K) {
        __data_start = .;
        __stack_bottom = .;
        . += CONFIG_BOOT_STACK_KIB * 1K;
        . = ALIGN(4K);
        __stack_top = .;
    }

    .data : ALIGN(4K) {
        *(.data .data.*)
        /* Named rather than left to orphan placement. `.got` carries SHF_WRITE, so
         * the linker ranks it with the writable sections and would drop it next to
         * the nearest match — which, in this layout, is the guard page hole. A
         * section that lands *there* is one the address space builder will refuse to
         * map, discovered as a fault rather than as a link error. It is a few bytes
         * of link-time-resolved addresses in a non-PIE image; the writable region is
         * where a writable input section belongs. */
        *(.got .got.plt)
        *(.data.rel.ro .data.rel.ro.*)
    }

    .bss (NOLOAD) : ALIGN(4K) {
        __bss_start = .;
        *(.bss .bss.*)
        *(COMMON)
        . = ALIGN(4K);
        __bss_end = .;
    }

    /* Kernel thread stacks: THREAD_STACK_SLOTS slots of THREAD_STACK_SLOT bytes, each a
     * guard page followed by the stack. Only the run is reserved here. The slot
     * geometry is `THREAD_STACK_SLOT` in `src/lib.rs`, and the address-space builder
     * leaves the bottom page of every slot unmapped, so a thread that overflows its
     * stack faults instead of writing into the stack of the thread below it. Last in
     * the writable run, so a slot's guard page is never the only thing between two
     * unrelated sections. */
    .thread_stacks (NOLOAD) : ALIGN(4K) {
        __thread_stacks_start = .;
        . += THREAD_STACK_SLOTS * THREAD_STACK_SLOT;
        __thread_stacks_end = .;
    }

    __data_end = .;
    __kernel_end = .;

    /DISCARD/ : {
        *(.eh_frame)
        *(.note .note.*)
        *(.comment)
    }
}

/* The Rust side computes the slot count by shifting, and aarch64's exception entry tests
 * for a guard hit with a mask. Both need whole, page-aligned, power-of-two slots. */
ASSERT((THREAD_STACK_SLOT & (THREAD_STACK_SLOT - 1)) == 0, "THREAD_STACK_KIB is not a power of two, which hal::StackArray requires")
ASSERT(THREAD_STACK_SLOT >= 8K, "THREAD_STACK_KIB leaves no stack above the guard page")
ASSERT(__thread_stacks_start % 4K == 0, "__thread_stacks_start is not page-aligned")
ASSERT((__thread_stacks_end - __thread_stacks_start) % THREAD_STACK_SLOT == 0, "thread stacks are not whole slots")
ASSERT(__stack_guard_end == __stack_bottom, "the boot stack does not start on its guard page")
ASSERT(__stack_top - __stack_bottom == ALIGN(CONFIG_BOOT_STACK_KIB * 1K, 4K), "the boot stack is not BOOT_STACK_KIB, rounded up to a page")
